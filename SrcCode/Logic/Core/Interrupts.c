//=========================================================
// src/Interrupts.c: generated by Hardware Configurator
//
// This file will be regenerated when saving a document.
// leave the sections inside the "$[...]" comment tags alone
// or they will be overwritten!
//=========================================================

// USER INCLUDES
#include <SI_EFM8UB2_Register_Enums.h>
#include "Limits.h"
#include "Global.h"

uint8_t cRam TickTime100ms = 0;   //static
uint8_t cRam TickTime500ms = 0;   //static
uint8_t cRam TickTime1000ms = 0;  //static

void TIMER0_ISR (void) interrupt TIMER0_IRQn using 1 // Interrupt_1
{
  TH0 = (uint8_t)((UINT_MAX-10000)/0xFF);
	TL0 = (uint8_t)((UINT_MAX-10000)%0xFF);

  SysHandle |= BTN_HANDLE_MASK; 
  
  TickTime100ms ++;
  TickTime500ms ++;
  TickTime500ms ++;
  
//  timer_cnt++ ;
}


uint8_t cRam RX_Data;
uint8_t cRam state, rx_len, rx_cnt;

void UART1_ISR (void) interrupt UART1_IRQn using 2  // Interrupt_16
{  
 	if(SCON1 & 0x01) {
		SCON1 &=  ~0x01;
		RX_Data = SBUF1;
	}

	if(state == 0 && RX_Data == 0xD8){
		state = 1 ;
		RxSocketDat[0] = RX_Data ;
	}else if(state == 1 && RX_Data < 20){
		state = 2 ;
		RxSocketDat[1] = RX_Data ;
		rx_len = RX_Data ;
		rx_cnt = 0 ;
	}else if(state == 2 && rx_len > 0){
		rx_len-- ;
		RxSocketDat[2 + rx_cnt] = RX_Data ;
		rx_cnt++ ;
		if(rx_len == 0){
			state =3 ;
		}
	}else if(state == 3){
		state = 0 ;
		RxSocketDat[2+rx_cnt] = RX_Data;
		UART_Data_Handler_Flag = 1 ;
	}else{
		state = 0 ;
	}
}



